## linux/linux-2.6.22.19/block/Kconfig
```kconfig
#
# Block layer core configuration
#
config BLOCK
       bool "Enable the block layer" if EMBEDDED
       default y
       help
	 This permits the block layer to be removed from the kernel if it's not
	 needed (on some embedded devices for example).  If this option is
	 disabled, then blockdev files will become unusable and some
	 filesystems (such as ext3) will become unavailable.

	 This option will also disable SCSI character devices and USB storage
	 since they make use of various block layer definitions and
	 facilities.

	 Say Y here unless you know you really don't want to mount disks and
	 suchlike.

if BLOCK

config LBD
	bool "Support for large block devices and files"
	depends on !64BIT
	help
	  Enable block devices or files of size 2TB and larger.

 	  This option is required to support the full capacity of large
 	  (2TB+) block devices, including RAID, disk, Network Block Device,
 	  Logical Volume Manager (LVM) and loopback.

	  This option also enables support for single files larger than
	  2TB.

	  If unsure, say N.

config BLK_DEV_IO_TRACE
	bool "Support for tracing block io actions"
	depends on SYSFS
	select RELAY
	select DEBUG_FS
	help
	  Say Y here, if you want to be able to trace the block layer actions
	  on a given queue. Tracing allows you to see any traffic happening
	  on a block device queue. For more information (and the user space
	  support tools needed), fetch the blktrace app from:

	  git://brick.kernel.dk/data/git/blktrace.git

endif

source block/Kconfig.iosched
```

## linux/linux-2.6.22.19/fs/squashfs/Kconfig
```kconfig
config SQUASHFS_XATTR
	bool "Squashfs XATTR support"
	depends on SQUASHFS4
	help
	  Saying Y here includes support for extended attributes (xattrs).
	  Xattrs are name:value pairs associated with inodes by
	  the kernel or by users (see the attr(5) manual page).

	  If unsure, say N.

config SQUASHFS_ZLIB
	bool "Include support for ZLIB compressed file systems"
	depends on SQUASHFS4
	select ZLIB_INFLATE
	default y
	help
	  ZLIB compression is the standard compression used by Squashfs
	  file systems.  It offers a good trade-off between compression
	  achieved and the amount of CPU time and memory necessary to
	  compress and decompress.

	  If unsure, say Y.

config SQUASHFS_LZO
	bool "Include support for LZO compressed file systems"
	depends on SQUASHFS4
	select LZO_DECOMPRESS
	help
	  Saying Y here includes support for reading Squashfs file systems
	  compressed with LZO compression.  LZO compression is mainly
	  aimed at embedded systems with slower CPUs where the overheads
	  of zlib are too high.

	  LZO is not the standard compression used in Squashfs and so most
	  file systems will be readable without selecting this option.

	  If unsure, say N.

config SQUASHFS_XZ
	bool "Include support for XZ compressed file systems"
	depends on SQUASHFS4
	select XZ_DEC
	help
	  Saying Y here includes support for reading Squashfs file systems
	  compressed with XZ compression.  XZ gives better compression than
	  the default zlib compression, at the expense of greater CPU and
	  memory overhead.

	  XZ is not the standard compression used in Squashfs and so most
	  file systems will be readable without selecting this option.

	  If unsure, say N.

config SQUASHFS_LZMA
	bool "Include support for LZMA compressed file systems"
	depends on SQUASHFS4
	help
	  Saying Y here includes support for reading Squashfs file systems
	  compressed with LZMA compression. LZMA gives better compression
	  than the default zlib compression.

	  LZMA is not the standard compression used in Squashfs and so most
	  file systems will be readable without selecting this option.

	  If unsure, say N.

config SQUASHFS_4K_DEVBLK_SIZE
	bool "Use 4K device block size?"
	depends on SQUASHFS4
	help
	  By default Squashfs sets the dev block size (sb_min_blocksize)
	  to 1K or the smallest block size supported by the block device
	  (if larger).  This, because blocks are packed together and
	  unaligned in Squashfs, should reduce latency.

	  This, however, gives poor performance on MTD NAND devices where
	  the optimal I/O size is 4K (even though the devices can support
	  smaller block sizes).

	  Using a 4K device block size may also improve overall I/O
	  performance for some file access patterns (e.g. sequential
	  accesses of files in filesystem order) on all media.

	  Setting this option will force Squashfs to use a 4K device block
	  size by default.

	  If unsure, say N.
```

## toolchain/toolchain/binutils/Config.in
```kconfig
# Choose binutils version.

choice
	prompt "Binutils Version"
	default BINUTILS_VERSION_2_23_2
	help
	  Select the version of binutils you wish to use.

	config BINUTILS_VERSION_2_19_1
		bool "binutils 2.19.1"

	config BINUTILS_VERSION_2_21_1
		bool "binutils 2.21.1"

	config BINUTILS_VERSION_2_23_2
		bool "binutils 2.23.2"

	config BINUTILS_VERSION_2_24
		bool "binutils 2.24"

endchoice

config EXTRA_BINUTILS_CONFIG_OPTIONS
	string
	prompt "Additional binutils options"
	default ""
	help
	    Any additional binutils options you may want to include....

config BINUTILS_VERSION
	string
	default "2.19.1"          if BINUTILS_VERSION_2_19_1
	default "2.21.1"          if BINUTILS_VERSION_2_21_1
	default "2.23.2"          if BINUTILS_VERSION_2_23_2
	default "2.24"            if BINUTILS_VERSION_2_24
	default "2.23.2"
```

## toolchain/toolchain/gcc/Config.in
```kconfig
# Choose gcc version.

choice
	prompt "GCC compiler Version"
	default GCC_VERSION_4_6_4
	help
	  Select the version of gcc you wish to use.

	config GCC_VERSION_3_4_6
		bool "gcc 3.4.6"

	config GCC_VERSION_4_4_7
		bool "gcc 4.4.7"

	config GCC_VERSION_4_6_4
		bool "gcc 4.6.4"

	config GCC_VERSION_4_8_4
		bool "gcc 4.8.4"

endchoice

config EABI_SUPPORT
	bool
	depends arm||armeb
	prompt "Enable EABI support"
	default n
	help
	  Enable ARM EABI support

config EXTRA_GCC_CONFIG_OPTIONS
	string
	prompt "Additional gcc options"
	default ""
	help
	    Any additional gcc options you may want to include....

config SSP_SUPPORT
	bool
	depends !GCC_VERSION_3_4_6
	prompt "Enable Stack-Smashing Protection support"
	default n
	help
	    Enable Stack-Smashing Protection support

config TLS_SUPPORT
	bool
	depends !GCC_VERSION_3_4_6 && !LINUX_2_4 && UCLIBC_VERSION_0_9_32
	prompt "Enable Thread-local storage (TLS) support"
	default n
	help
	    Enable Thread-local storage support

config INSTALL_LIBSTDCPP
	bool
	prompt "Build/install c++ compiler and libstdc++?"
	default y
	help
	    Build/install c++ compiler and libstdc++?
```

## toolchain/toolchain/uClibc/Config.in
```kconfig
# Choose uclibc version.

choice
	prompt "uClibc Version"
	default UCLIBC_VERSION_0_9_30
	help
	  Select the version of uClibc you wish to use.
	  Default is 0.9.30 .

	config UCLIBC_VERSION_SNAPSHOT
		depends !LINUX_2_4
		bool "uClibc snapshot"

	config UCLIBC_VERSION_0_9_29
		bool "uClibc 0.9.29"

	config UCLIBC_VERSION_0_9_30
		bool "uClibc 0.9.30"

	config UCLIBC_VERSION_0_9_32
		depends !LINUX_2_4
		bool "uClibc 0.9.32"
endchoice


config UCLIBC_ENABLE_DEBUG
	bool "Build with debug information"
	default n
```
